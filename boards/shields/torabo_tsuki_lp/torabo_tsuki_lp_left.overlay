#include "torabo_tsuki_lp.dtsi"
#include <input/processors.dtsi>
#include <dt-bindings/zmk/input_transform.h>
#include <scroll-snap.dtsi>

&pointing_listener {
    input-processors = <&zip_xy_transform (INPUT_TRANSFORM_X_INVERT | INPUT_TRANSFORM_Y_INVERT)>;

    scroll_layer_1_4_11_14 {
        layers = <1 4 11 14>;
        input-processors = <
            &zip_xy_to_scroll_mapper
            &zip_scroll_snap
            &zip_scroll_scaler 1 5
        >;
    };
};